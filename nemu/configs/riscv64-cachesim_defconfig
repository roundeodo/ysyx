## nemu/configs/riscv64-cachesim_defconfig
```kconfig
CONFIG_RV64=y
CONFIG_TARGET_NATIVE_ELF=y
CONFIG_TRACE=y
CONFIG_TRACE_END=1000000000
# CONFIG_ITRACE is not set
CONFIG_CACHESIM_TRACE=y
CONFIG_BRANCHSIM_TRACE=y
# CONFIG_IRINGBUF is not set
CONFIG_MSIZE=0x8000000
CONFIG_DEVICE=y
```

## nemu/configs/riscv64-ref_defconfig
```kconfig
CONFIG_RV64=y
CONFIG_TARGET_SHARE=y
# CONFIG_TRACE is not set
CONFIG_MSIZE=0x2000000
```
