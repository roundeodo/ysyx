## nemu/configs/riscv64-ref_defconfig
```kconfig
CONFIG_RV64=y
CONFIG_TARGET_SHARE=y
# CONFIG_TRACE is not set
CONFIG_YSYXSOC_MEMORY=y
CONFIG_MBASE=0x30000000
CONFIG_MSIZE=0x1000000
# CONFIG_MEM_RANDOM is not set
```
